#include "screen.h"
#include "math.h"
#include "string.h"
#include "stdlib.h"

unsigned short pixels_565[WINDOW_HEIGHT][WINDOW_WIDTH];
float linespace = 1.5;

/**
 * @brief Print a character
 *
 * @param pos position of the character
 * @param ch the character code
 * @return next position after print
 */
pos_t _putc(pos_t pos, char ch) {
	if (ch == '\n')
		return POS(MARGIN_X, Y(pos) + linespace * MONO_HEIGHT);
	short x = X(pos), y = Y(pos);
	if (x + MONO_WIDTH > WINDOW_WIDTH - MARGIN_X) {
		x = MARGIN_X;
		y += linespace * MONO_HEIGHT;
	}
	if (y + MONO_HEIGHT > WINDOW_HEIGHT - MARGIN_Y)
		y = Y(scrollup(POS(x, y), 1));
//	unsigned short (*img)[MONO_WIDTH] =
//			(unsigned short (*)[MONO_WIDTH]) monofont[(int) ch];
	unsigned short (*img)[MONO_WIDTH] = (unsigned short (*)[MONO_WIDTH]) malloc(
			sizeof(unsigned short[MONO_WIDTH]));
	for (int i = 0; i < MONO_HEIGHT; i++)
		for (int j = 0; j < MONO_WIDTH; j++)
			pixels_565[y + i][x + j] = img[i][j];
	free(img);
	return POS(x + MONO_WIDTH, y);
}

/**
 * @brief Print a string
 *
 * @param pos position of the string
 * @param s the string
 * @return next position after print
 */
pos_t _puts(pos_t pos, char *s) {
	while (*s)
		pos = _putc(pos, *s++);
	return pos;
}

/**
 * @brief Print an unsigned long integer
 *
 * @param pos position of the integer
 * @param ul the unsigned long integer
 * @param base base of the integer
 *
 * @return next position after print
 */
pos_t _putul(pos_t pos, unsigned long ul, int base) {
	unsigned long div = ul / base;
	char digit = ul % base;
	digit += digit < 10 ? '0' : 'A' - 10;
	return _putc(div ? _putul(pos, div, base) : pos, digit);
}

/**
 * @brief Print a long integer
 *
 * @param pos position of the integer
 * @param l the long integer
 * @param base base of the integer
 *
 * @return next position after print
 */
pos_t _putl(pos_t pos, long l, int base) {
	unsigned long ul;
	if (l >= 0)
		ul = l;
	else {
		ul = -l;
		pos = _putc(pos, '-');
	}
	return _putul(pos, ul, base);
}

/**
 * @brief Print a float number
 *
 * @param pos position of the number
 * @param f the float number
 * @param n length of fraction
 *
 * @return next position after print
 */
pos_t _putf(pos_t pos, float f, int n) {
	if (f < 0) {
		f = -f;
		pos = _putc(pos, '-');
	}
	pos = _putul(pos, (unsigned long) f, 10);
	pos = _putc(pos, '.');
	f = (f - (unsigned long) f) * 10.f;
	for (int i = 0; i < n; i++) {
		pos = _putc(pos, '0' + (unsigned long) f);
		f = (f - (unsigned long) f) * 10.f;
	}
	return pos;
}

/**
 * @brief Clear screen with a specific color
 *
 * @param c the color
 */
pos_t clrscreen(color_t c) {
	for (int i = 0; i < WINDOW_HEIGHT; i++)
		for (int j = 0; j < WINDOW_WIDTH; j++)
			pixels_565[i][j] = c;
	return POS(MARGIN_X, MARGIN_Y);
}

/**
 * @brief move the screen up
 *
 * @param pos current position
 * @param n number of lines to scroll up
 * @return next position after scrolling up
 */
pos_t scrollup(pos_t pos, int n) {
	int d = n * linespace * MONO_HEIGHT;
	for (int i = 0; i < WINDOW_HEIGHT - d; i++)
		for (int j = 0; j < WINDOW_WIDTH; j++)
			pixels_565[i][j] = pixels_565[i + d][j];
	for (int i = WINDOW_HEIGHT - d; i < WINDOW_HEIGHT; i++)
		for (int j = 0; j < WINDOW_WIDTH; j++)
			pixels_565[i][j] = 0xffff;
	return POS(X(pos), Y(pos) - d);
}

/**
 * @brief Fill a rectangle with specific color
 *
 * @param a one point
 * @param b another point
 * @param c the color
 */
void fill_rect(pos_t a, pos_t b, color_t c) {
	int xs = X(a), xe = X(b), ys = Y(a), ye = Y(b);
	for (int i = ys; i <= ye; i++)
		for (int j = xs; j <= xe; j++)
			if (IN_WINDOW(i, j))
				pixels_565[i][j] = c;
}

/**
 * @brief Calculate the area proportion in a unit square divided by a line
 *
 * @param x x-coordinate of one point on the line
 * @param y y-coordinate of one point on the line
 * @param cth the cosine of tilt angle
 * @param sth the sine of tile angle
 * @return val one proportion of the separation result
 */
double partial_area(double x, double y, double cth, double sth) {
	x -= (int) x;
	y -= (int) y;
	double l1, l2, l3, l4, k = sth / cth;
	l1 = y - x * k;
	l2 = y + (1 - x) * k;
	l3 = x - y / k;
	l4 = x + (1 - y) / k;
	int b1, b2, b3, b4;
	b1 = -.001 < l1 && l1 < 1.001;
	b2 = -.001 < l2 && l2 < 1.001;
	b3 = -.001 < l3 && l3 < 1.001;
	b4 = -.001 < l4 && l4 < 1.001;
	double ret;
	if (b1 && b2) {
		return cth > .0 ? (l1 + l2) / 2. : 1. - (l1 + l2) / 2.;
	} else {
		if (b1 && b3)
			ret = 1. - l1 * l3 / 2.;
		else if (b1 && b4)
			ret = 1. - (1. - l1) * l4 / 2.;
		else if (b2 && b3)
			ret = l2 * (1. - l3) / 2.;
		else if (b2 && b4)
			ret = (1. - l2) * (1. - l4) / 2.;
		else if (b3 && b4)
			ret = 1. - (l3 + l4) / 2.;
		else
			ret = NAN;
		return sth > .0 ? ret : 1. - ret;
	}
}

/**
 * @brief Draw a line
 *
 * @param a one point
 * @param b another point
 * @param c the color
 * @param stroke the width of the line
 * @param aa whether needs anti-aliasing
 */
void draw_line(point_t a, point_t b, color_t c, double stroke, int aa) {
	double dx = b.x - a.x, dy = b.y - a.y;
	double ox = (a.x + b.x) / 2., oy = (a.y + b.y) / 2.;
	double d = stroke / 2., l = sqrt(dx * dx + dy * dy) / 2.;
	double cth = dx / 2. / l, sth = dy / 2. / l;
	double u, v, step = 1. / sqrt(2.);
	for (u = -d; u < d; u += step)
		for (v = -l; v < l; v += step) {
			int x = ox + u * sth + v * cth, y = oy - u * cth + v * sth;
			if (IN_WINDOW(x, y))
				draw_dot(x, y, c);
		}
	double umax = u, vmax = v;
	double uini[] = { -d, -d, -d - step, umax };
	double ulmt[] = { d, d, -d, umax + step };
	double vini[] = { -l - step, vmax, -l, -l };
	double vlmt[] = { -l, vmax + step, l, l };
	double ustep[] = { step, step, .0, .0 };
	double vstep[] = { .0, .0, step, step };
	double ang1[] = { sth, -sth, -cth, cth };
	double ang2[] = { -cth, cth, -sth, sth };
	for (int i = 0; i < 4; i++) {
		int x_pre = -1, y_pre = -1, c_pre;
		u = uini[i];
		v = vini[i];
		do {
			double x = ox + u * sth + v * cth, y = oy - u * cth + v * sth;
			if (IN_WINDOW(x, y)) {
				int x_tr = (int) x, y_tr = (int) y;
				if (aa) {
					double s1 = partial_area(x, y, ang1[i], ang2[i]);
					if (x_pre != x_tr || y_pre != y_tr) {
						c_pre = pixels_565[y_tr][x_tr];
						x_pre = x_tr;
						y_pre = y_tr;
					}
					draw_dot(x_tr, y_tr,
							color_ratio(c_pre, s1) + color_ratio(c, 1. - s1));
				} else
					draw_dot(x_tr, y_tr, c);
			}
			u += ustep[i];
			v += vstep[i];
		} while (u < ulmt[i] && v < vlmt[i]);
	}
}
/**
 * @brief Draw an ellipse
 *
 * @param ct position of center
 * @param r radiuses of the ellipse
 * @param c the color
 * @param stroke the width of the line
 * @param aa whether needs anti-aliasing
 */
void draw_ellipse(point_t ct, point_t r, color_t c, double stroke, int aa) {
	double dpi = 2. * acos(-1), rstep = 1. / sqrt(2.), tstep = rstep
			/ ((r.x > r.y ? r.x : r.y) + (stroke /= 2.)), dr;
	for (dr = -stroke; dr < stroke; dr += rstep)
		for (double t = .0; t < dpi; t += tstep) {
			int x = ct.x + (r.x + dr) * cos(t), y = ct.y + (r.y + dr) * sin(t);
			if (IN_WINDOW(x, y))
				draw_dot(x, y, c);
		}
	double rxbound[] = { r.x - stroke - rstep, r.x + dr };
	double rybound[] = { r.y - stroke - rstep, r.y + dr };
	for (int i = 0; i < 2; i++) {
		int x_pre = -1, y_pre = -1, c_pre;
		for (double t = .0; t < dpi; t += tstep) {
			double cth = cos(t), sth = sin(t);
			double x = ct.x + rxbound[i] * cth, y = ct.y + rybound[i] * sth;
			if (IN_WINDOW(x, y)) {
				int x_tr = (int) x, y_tr = (int) y;
				if (aa) {
					double s1 = partial_area(x, y, (1 - 2 * i) * sth,
							(2 * i - 1) * cth);
					if (x_pre != x_tr || y_pre != y_tr) {
						c_pre = pixels_565[y_tr][x_tr];
						x_pre = x_tr;
						y_pre = y_tr;
					}
					draw_dot(x_tr, y_tr,
							color_ratio(c_pre, s1) + color_ratio(c, 1. - s1));
				} else
					draw_dot(x_tr, y_tr, c);
			}
		}
	}
}

/**
 * @brief Outline a bezier curve
 *
 * @param ord order of bezier curve, 1 (linear), 2 (quadratic) or 3 (cubic)
 * @param p the pointer of points, which should contain (order + 1) points
 * @param c the color
 * @param aa whether needs anti-aliasing
 * @param draw whether to draw
 * @return border rectangle
 */
rect_t outline_bezier(int ord, point_t *p, color_t c, int draw, int aa) {
	double step;
	int x_pre = -1, y_pre = -1, c_pre;
	rect_t bd = (rect_t ) { p[0].x, p[0].y, p[0].x, p[0].y };
	for (double t = 0; t < 1; t += step) {
		double x, y, dx, dy, s = 1. - t;
		if (ord == 1) {
			x = p[0].x * s + p[1].x * t;
			y = p[0].y * s + p[1].y * t;
			dx = p[1].x - p[0].x;
			dy = p[1].y - p[0].y;
		} else if (ord == 2) {
			x = s * s * p[0].x + 2 * s * t * p[1].x + t * t * p[2].x;
			y = s * s * p[0].y + 2 * s * t * p[1].y + t * t * p[2].y;
			dx = 2 * s * (p[1].x - p[0].x) + 2 * t * (p[2].x - p[1].x);
			dy = 2 * s * (p[1].y - p[0].y) + 2 * t * (p[2].y - p[1].y);
		} else if (ord == 3) {
			x = s * s * s * p[0].x + 3 * s * s * t * p[1].x
					+ 3 * s * t * t * p[2].x + t * t * t * p[3].x;
			y = s * s * s * p[0].y + 3 * s * s * t * p[1].y
					+ 3 * s * t * t * p[2].y + t * t * t * p[3].y;
			dx = 3 * s * s * (p[1].x - p[0].x) + 6 * s * t * (p[2].x - p[1].x)
					+ 3 * t * t * (p[3].x - p[2].x);
			dy = 3 * s * s * (p[1].y - p[0].y) + 6 * s * t * (p[2].y - p[1].y)
					+ 3 * t * t * (p[3].y - p[2].y);
		}
		if (x < bd.l)
			bd.l = x;
		else if (x > bd.r)
			bd.r = x;
		if (y < bd.t)
			bd.t = y;
		else if (y > bd.b)
			bd.b = y;
		step = .7 / sqrt(dx * dx + dy * dy);
		int x_tr = (int) x, y_tr = (int) y;
		if (draw && aa && IN_WINDOW(x_tr, y_tr)) {
			double dr = sqrt(dx * dx + dy * dy);
			double s1 = partial_area(x, y, dx / dr, dy / dr);
			if (x_pre != x_tr || y_pre != y_tr) {
				c_pre = pixels_565[y_tr][x_tr];
				x_pre = x_tr;
				y_pre = y_tr;
			}
			draw_dot(x_tr, y_tr,
					color_ratio(c_pre, s1) + color_ratio(c, 1. - s1));
		} else if (draw && IN_WINDOW(x_tr, y_tr))
			draw_dot(x_tr, y_tr, c);
	}
	return bd;
}

/**
 * @brief Fill a closed bezier curve
 *
 * @param ord order of bezier curve, 1 (linear), 2 (quadratic) or 3 (cubic)
 * @param pp the pointer of points, which should contain (order + 1) points
 * @param c the color
 * @param bitout bitmap output
 * @param border real border of the curve
 */
void fill_bezier(int ord, point_t *p, char *bitout, rect_t border) {
	double step;
	int wd = border.r - border.l + 1, ht = border.b - border.t + 1;
	int bitsz = wd * ht / 8 + 1;
	char *pre = (char*) malloc(bitsz), *cur = (char*) malloc(bitsz);
	memset(pre, 0, bitsz);
	double xb = p[0].x, yb = p[0].y;
	double xe = p[ord].x, ye = p[ord].y;
	for (double t = 0; t < 1; t += step) {
		double x, y, dx, dy, s = 1. - t;
		if (ord == 1) {
			x = p[0].x * s + p[1].x * t;
			y = p[0].y * s + p[1].y * t;
			dx = p[1].x - p[0].x;
			dy = p[1].y - p[0].y;
		} else if (ord == 2) {
			x = s * s * p[0].x + 2 * s * t * p[1].x + t * t * p[2].x;
			y = s * s * p[0].y + 2 * s * t * p[1].y + t * t * p[2].y;
			dx = 2 * s * (p[1].x - p[0].x) + 2 * t * (p[2].x - p[1].x);
			dy = 2 * s * (p[1].y - p[0].y) + 2 * t * (p[2].y - p[1].y);
		} else if (ord == 3) {
			x = s * s * s * p[0].x + 3 * s * s * t * p[1].x
					+ 3 * s * t * t * p[2].x + t * t * t * p[3].x;
			y = s * s * s * p[0].y + 3 * s * s * t * p[1].y
					+ 3 * s * t * t * p[2].y + t * t * t * p[3].y;
			dx = 3 * s * s * (p[1].x - p[0].x) + 6 * s * t * (p[2].x - p[1].x)
					+ 3 * t * t * (p[3].x - p[2].x);
			dy = 3 * s * s * (p[1].y - p[0].y) + 6 * s * t * (p[2].y - p[1].y)
					+ 3 * t * t * (p[3].y - p[2].y);
		}
		step = .7 / sqrt(dx * dx + dy * dy);
		double ratio = ((x - xb) * (xe - xb) + (y - yb) * (ye - yb))
				/ ((xe - xb) * (xe - xb) + (ye - yb) * (ye - yb));
		double xp = xb + ratio * (xe - xb), yp = yb + ratio * (ye - yb);
		double ustep = .7 / sqrt((xp - x) * (xp - x) + (yp - y) * (yp - y));
		memset(cur, 0, bitsz);
		for (double u = 0; u < 1; u += ustep) {
			double v = 1. - u;
			int xtr = x * v + xp * u - border.l;
			int ytr = y * v + yp * u - border.t;
			if (xtr >= 0 && xtr < wd && ytr >= 0 && ytr < ht) {
				int idx = xtr + ytr * wd;
				if (!testbit(pre, idx) && !testbit(cur, idx))
					togglebit(bitout, idx);
				setbit(cur, idx);
			}
		}
		char *tmp = pre;
		pre = cur;
		cur = tmp;
	}
	free(pre);
	free(cur);
	for (double t = 0; t < 1; t += step) {
		double x, y, dx, dy, s = 1. - t;
		if (ord == 1) {
			x = p[0].x * s + p[1].x * t;
			y = p[0].y * s + p[1].y * t;
			dx = p[1].x - p[0].x;
			dy = p[1].y - p[0].y;
		} else if (ord == 2) {
			x = s * s * p[0].x + 2 * s * t * p[1].x + t * t * p[2].x;
			y = s * s * p[0].y + 2 * s * t * p[1].y + t * t * p[2].y;
			dx = 2 * s * (p[1].x - p[0].x) + 2 * t * (p[2].x - p[1].x);
			dy = 2 * s * (p[1].y - p[0].y) + 2 * t * (p[2].y - p[1].y);
		} else if (ord == 3) {
			x = s * s * s * p[0].x + 3 * s * s * t * p[1].x
					+ 3 * s * t * t * p[2].x + t * t * t * p[3].x;
			y = s * s * s * p[0].y + 3 * s * s * t * p[1].y
					+ 3 * s * t * t * p[2].y + t * t * t * p[3].y;
			dx = 3 * s * s * (p[1].x - p[0].x) + 6 * s * t * (p[2].x - p[1].x)
					+ 3 * t * t * (p[3].x - p[2].x);
			dy = 3 * s * s * (p[1].y - p[0].y) + 6 * s * t * (p[2].y - p[1].y)
					+ 3 * t * t * (p[3].y - p[2].y);
		}
		step = .7 / sqrt(dx * dx + dy * dy);
		int idx = (int) (x - border.l) + ((int) (y - border.t)) * wd;
		unsetbit(bitout, idx);
	}
}

/**
 * @brief Outline an SVG path
 *
 * @param h rendering box height
 * @param len length of pathdata
 * @param pathdata the encoded path data
 * @param c the color
 * @param draw whether to draw
 * @param aa whether needs anti-aliasing
 * @return border rectangle
 */
rect_t outline_svg_path(pos_t ori, int h, int len, const short *pathdata,
		color_t c, int draw, int aa) {
	int i = 0;
	point_t p[3], start;
	double ratio = h / 32768., ox = X(ori), oy = Y(ori);
	rect_t rcmax = (rect_t ) { -1, -1, -1, -1 }, rc;
	while (i < len) {
		double d1, d2, d3, d4;
		switch (pathdata[i]) {
		case 'M':
			d1 = pathdata[++i] * ratio;
			d2 = pathdata[++i] * ratio;
			start = p[0] = (point_t ) { ox + d1, oy + d2 };
			rc = (rect_t ) { start.x, start.y, start.x, start.y };
			break;
		case 'z':
			if (start.x == p[0].x && start.y == p[0].y)
				break;
			p[1] = start;
			rc = outline_bezier(1, p, c, draw, aa);
			break;
		case 'h':
			d1 = pathdata[++i] * ratio;
			p[1] = (point_t ) { p[0].x + d1, p[0].y };
			rc = outline_bezier(1, p, c, draw, aa);
			p[0] = p[1];
			break;
		case 'v':
			d1 = pathdata[++i] * ratio;
			p[1] = (point_t ) { p[0].x, p[0].y + d1 };
			rc = outline_bezier(1, p, c, draw, aa);
			p[0] = p[1];
			break;
		case 'l':
			d1 = pathdata[++i] * ratio;
			d2 = pathdata[++i] * ratio;
			p[1] = (point_t ) { p[0].x + d1, p[0].y + d2 };
			rc = outline_bezier(1, p, c, draw, aa);
			p[0] = p[1];
			break;
		case 't':
			d1 = pathdata[++i] * ratio;
			d2 = pathdata[++i] * ratio;
			p[1] = (point_t ) { p[0].x * 2 - p[1].x, p[0].y * 2 - p[1].y };
			p[2] = (point_t ) { p[0].x + d1, p[0].y + d2 };
			rc = outline_bezier(2, p, c, draw, aa);
			p[0] = p[2];
			break;
		case 'q':
			d1 = pathdata[++i] * ratio;
			d2 = pathdata[++i] * ratio;
			d3 = pathdata[++i] * ratio;
			d4 = pathdata[++i] * ratio;
			p[1] = (point_t ) { p[0].x + d1, p[0].y + d2 };
			p[2] = (point_t ) { p[0].x + d3, p[0].y + d4 };
			rc = outline_bezier(2, p, c, draw, aa);
			p[0] = p[2];
			break;
		default:
			rcmax = (rect_t ) { -1, -1, -1, -1 };
			return rcmax;
		}
		if (rc.l < rcmax.l || rcmax.l == -1)
			rcmax.l = rc.l;
		if (rc.r > rcmax.r || rcmax.r == -1)
			rcmax.r = rc.r;
		if (rc.t < rcmax.t || rcmax.t == -1)
			rcmax.t = rc.t;
		if (rc.b > rcmax.b || rcmax.b == -1)
			rcmax.b = rc.b;
		i++;
	}
	return rcmax;
}

/**
 * @brief Fill an SVG path
 */
void fill_svg_path(pos_t ori, int h, int len, const short *pathdata,
		char *bitout, rect_t border) {
	int i = 0;
	point_t p[3];
	double ratio = h / 32768., ox = X(ori), oy = Y(ori);
	while (i < len) {
		double d1, d2, d3, d4;
		switch (pathdata[i]) {
		case 'M':
			d1 = pathdata[++i] * ratio;
			d2 = pathdata[++i] * ratio;
			p[0] = (point_t ) { ox + d1, oy + d2 };
			break;
		case 'z':
			break;
		case 'h':
			d1 = pathdata[++i] * ratio;
			p[1] = (point_t ) { p[0].x + d1, p[0].y };
			fill_bezier(1, p, bitout, border);
			p[0] = p[1];
			break;
		case 'v':
			d1 = pathdata[++i] * ratio;
			p[1] = (point_t ) { p[0].x, p[0].y + d1 };
			fill_bezier(1, p, bitout, border);
			p[0] = p[1];
			break;
		case 'l':
			d1 = pathdata[++i] * ratio;
			d2 = pathdata[++i] * ratio;
			p[1] = (point_t ) { p[0].x + d1, p[0].y + d2 };
			fill_bezier(1, p, bitout, border);
			p[0] = p[1];
			break;
		case 't':
			d1 = pathdata[++i] * ratio;
			d2 = pathdata[++i] * ratio;
			p[1] = (point_t ) { p[0].x * 2 - p[1].x, p[0].y * 2 - p[1].y };
			p[2] = (point_t ) { p[0].x + d1, p[0].y + d2 };
			fill_bezier(2, p, bitout, border);
			p[0] = p[2];
			break;
		case 'q':
			d1 = pathdata[++i] * ratio;
			d2 = pathdata[++i] * ratio;
			d3 = pathdata[++i] * ratio;
			d4 = pathdata[++i] * ratio;
			p[1] = (point_t ) { p[0].x + d1, p[0].y + d2 };
			p[2] = (point_t ) { p[0].x + d3, p[0].y + d4 };
			fill_bezier(2, p, bitout, border);
			p[0] = p[2];
			break;
		default:
			return;
		}
		i++;
	}
}

/**
 * @brief Initialize the register of control chip of touch panal
 *
 * @param phi2c the pointer of I2C handle
 * @return whether successful
 */
char touch_reg_init(I2C_HandleTypeDef *phi2c) {
	unsigned char buf[3];
	char suc = 1;
	buf[0] = 0x00, buf[1] = 0x00;
	suc &= HAL_I2C_Master_Transmit(phi2c, 0x70, buf, 2, HAL_MAX_DELAY) == 0;
	buf[0] = 0xa4, buf[1] = 0x00;
	suc &= HAL_I2C_Master_Transmit(phi2c, 0x70, buf, 2, HAL_MAX_DELAY) == 0;
	buf[0] = 0x80, buf[1] = 0x46;
	suc &= HAL_I2C_Master_Transmit(phi2c, 0x70, buf, 2, HAL_MAX_DELAY) == 0;
	buf[0] = 0x88, buf[1] = 0x0c;
	suc &= HAL_I2C_Master_Transmit(phi2c, 0x70, buf, 2, HAL_MAX_DELAY) == 0;
	buf[0] = 0xa1, buf[1] = 0x30, buf[2] = 0x03;
	suc &= HAL_I2C_Master_Transmit(phi2c, 0x70, buf, 3, HAL_MAX_DELAY) == 0;
	return suc;
}

/**
 * @brief Retrieve the position of touch points
 *
 * @param phi2c pointer of I2C handle
 * @param px pointer of the result x coordinates
 * @param py pointer of the result y coordinates
 * @return number of pointers
 */
int touch_pos(I2C_HandleTypeDef *phi2c, short *px, short *py, short *status) {
	unsigned char addr[5] = { 0x03, 0x09, 0x0f, 0x15, 0x1b }, addr_num = 0x02;
	unsigned char buf[4];
	char suc = 1;
	unsigned char n = 0;
	suc &= HAL_I2C_Master_Transmit(phi2c, 0x70, &addr_num, 1, HAL_MAX_DELAY)
			== 0;
	suc &= HAL_I2C_Master_Receive(phi2c, 0x70, &n, 1, HAL_MAX_DELAY) == 0;
	if (!suc)
		n = 0;
	for (int i = 0; i < n; i++) {
		suc &= HAL_I2C_Master_Transmit(phi2c, 0x70, &addr[i], 1, HAL_MAX_DELAY)
				== 0;
		suc &= HAL_I2C_Master_Receive(phi2c, 0x70, buf, 4, HAL_MAX_DELAY) == 0;
		if (px)
			px[i] = (((buf[2] & 0x0f) << 8) | buf[3]) - ORIGIN_X;
		if (py)
			py[i] = (((buf[0] & 0x0f) << 8) | buf[1]) - ORIGIN_Y;
		if (status)
			status[i] = buf[0] >> 6;
	}
	return suc ? n : -1;
}

int vfont_pos[] = { 0, 70, 98, 182, 343, 573, 783, 797, 836, 875, 928, 956,
		1030, 1042, 1102, 1116, 1262, 1291, 1384, 1536, 1574, 1666, 1823, 1843,
		2043, 2194, 2314, 2448, 2467, 2491, 2510, 2642, 2899, 2932, 3053, 3134,
		3201, 3229, 3253, 3369, 3397, 3425, 3485, 3512, 3528, 3581, 3617, 3737,
		3805, 3966, 4067, 4221, 4241, 4307, 4335, 4391, 4424, 4456, 4482, 4502,
		4513, 4533, 4552, 4564, 4579, 4714, 4827, 4911, 5008, 5130, 5182, 5460,
		5527, 5609, 5727, 5754, 5778, 5902, 5967, 6087, 6196, 6297, 6352, 6502,
		6563, 6625, 6650, 6706, 6739, 6811, 6837, 6937, 6949, 7049, 7141 };

short vfont_path[] = { 0x004d, 0x29a0, 0x06c0, 0x006c, 0xfe50, 0x4060, 0x0068,
		0xf660, 0x006c, 0xfe20, 0xbfa0, 0x0068, 0x0d30, 0x007a, 0x004d, 0x2310,
		0x4fb0, 0x0071, 0x01b0, 0x0000, 0x0330, 0x00a8, 0x0074, 0x0298, 0x01c8,
		0x0074, 0x01c0, 0x02a8, 0x0074, 0x00a8, 0x0338, 0x0074, 0xff58, 0x0330,
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		0x0074, 0x01b0, 0xf6c0, 0x0068, 0x0a00, 0x007a };
